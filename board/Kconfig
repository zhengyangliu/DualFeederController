## board/Kconfig
```kconfig
menu "Hardware Drivers Config"

config SOC_STM32F103C8
    bool
    select SOC_SERIES_STM32F1
    default y

menu "Onboard Peripheral Drivers"

endmenu

menu "On-chip Peripheral Drivers"

    config BSP_USING_GPIO
        bool "Enable GPIO"
        select RT_USING_PIN
        default y

    menuconfig BSP_USING_UART
        bool "Enable UART"
        default y
        select RT_USING_SERIAL
        if BSP_USING_UART
            config BSP_USING_UART1
                bool "Enable UART1"
                default y

            config BSP_UART1_RX_USING_DMA
                bool "Enable UART1 RX DMA"
                depends on BSP_USING_UART1 && RT_SERIAL_USING_DMA
                default n
        endif

    menuconfig BSP_USING_PWM
        bool "Enable PWM"
        default n
        select RT_USING_PWM
        if BSP_USING_PWM
        menuconfig BSP_USING_PWM2
            bool "Enable timer 2 output pwm"
            default n
            if BSP_USING_PWM2
                config BSP_USING_PWM2_CH1
                    bool "Enable PWM2 channel1"
                    default n
                config BSP_USING_PWM2_CH2
                    bool "Enable PWM2 channel2"
                    default n
            endif
        menuconfig BSP_USING_PWM3
            bool "Enable timer 3 output pwm"
            default n
            if BSP_USING_PWM3
                config BSP_USING_PWM3_CH1
                    bool "Enable PWM3 channel1"
                    default n
                config BSP_USING_PWM3_CH3
                    bool "Enable PWM3 channel2"
                    default n
            endif
        endif
        

endmenu

menu "Board extended module Drivers"

endmenu

endmenu
```
